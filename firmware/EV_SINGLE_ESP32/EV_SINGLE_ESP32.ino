/*
===============================================================
EV BATTERY MONITOR — SINGLE ESP32, EVERYTHING ON ONE BOARD
===============================================================
Merges the two-board design (sensor node + compute/MQTT gateway)
back onto one chip now that the INMP441 (the reason for a second
ESP32 — I2S/ADC conflict) is gone.

What this board does:
  - Reads cell voltages through an ADS1115 (I2C) — not the
    ESP32's own ADC, so it is not affected by ADC drift/noise.
  - Reads DS18B20 cell temperatures (OneWire).
  - Reads current (ACS712), ambient temp/humidity (DHT11),
    piezo swelling sensors, and gas level — all on the ESP32's
    own ADC.
  - Runs the MOSFET PWM load control loop (LOAD/STOP commands).
  - Runs a PWM cooling fan driven by cell temperature.
  - Calculates every battery parameter locally: SOC, SOH, RUL,
    power, cell imbalance, thermal gradient, dT/dt, R0 estimate,
    SOE/SOF/SOP, power limits, energy throughput, equivalent
    cycles, time-to-empty/full.
  - Connects to WiFi/MQTT and publishes everything.
  - Prints the full sensor + parameter state to Serial every
    second, UNCONDITIONALLY — this never stops just because
    WiFi/MQTT is down. MQTT connect/retry/fail messages print
    alongside it, not instead of it.

IMPORTANT PIN NOTE: with WiFi now running on this chip, the gas
sensor was moved off GPIO25 to GPIO34. GPIO25 is an ADC2 pin,
and the ESP32's ADC2 bank is shared with the WiFi radio — reads
on it become unreliable whenever WiFi is active. GPIO34 is ADC1,
which is unaffected by WiFi. GPIO25 is reused for the fan PWM
output instead, which is fine: a digital PWM output doesn't
care about the ADC1/ADC2 split, only analogRead() does.

Sensor isolation: DS18B20 (OneWire) and the ADC reads are still
sequenced with a settle delay (temperature read ALONE, then a
wait, then current/other ADC reads) — this is carried over from
the original debugging fix for the OneWire/ADC noise-coupling
issue, and still applies even on one chip, because the problem
was electrical (supply-rail disturbance during an OneWire
transaction), not a two-chip software issue.

---------------------------------------------------------------
REV B additions (everything above is unchanged):
  * EDGE AI - the trained XGBoost health model (health_model.h,
    generated by export_model_to_c.py on the laptop) runs ON THIS
    CHIP. At the end of every discharge of 5 min or longer it
    estimates state of health from mean cell voltage, mean cell
    temperature and cycle count, explains the estimate (SHAP) and
    publishes to battery/ai_edge. No laptop or cloud needed.
  * DEMO MODE (battery/cmd/sys "DEMO_ON" / "DEMO_OFF") - the board
    stops publishing its own readings and instead runs its on-chip
    AI on the NASA replay coming from the laptop. Sent automatically
    by demo_nasa_replay.py / fake_publisher.py. Ends by itself if the
    laptop stops sending for 30 s. Load is forced off in demo mode.
  * TWO-WAY CONTROL from the digital twin:
      LIMIT:<amps>   cap the load current (twin sends this on a
                     resistance jump), LIMIT:OFF removes the cap
      FAN:<0-100>    fan duty override in %, FAN:AUTO = temperature curve
      SYNC           reset SOC from resting cell voltage (OCV table)
  * Coulomb counting uses the MEASURED time between readings. The
    loop takes longer than 1 s (the DS18B20 conversion alone is up to
    750 ms), so assuming exactly 1 s under-counted charge.
  * safety_active / safety_reason / current_limit_A / fan_mode /
    demo_mode added to the published JSON.

CHECK BEFORE TRUSTING CURRENT: ACS712_SENS_V_PER_A must match the
module printed on your ACS712 chip: 5A = 0.185, 20A = 0.100,
30A = 0.066 (current value). A mismatch scales every current reading.
---------------------------------------------------------------

Board: ESP32 Dev Module (or ESP32-S3)
Baud: 115200
Libraries needed: DHT sensor library, OneWire, DallasTemperature,
                   Adafruit_ADS1X15, WiFi, PubSubClient, ArduinoJson
FOLDER: keep health_model.h in this sketch folder (EV_SINGLE_ESP32).
===============================================================
*/

#include <Arduino.h>
#include <WiFi.h>
#include <PubSubClient.h>
#include <ArduinoJson.h>
#include <DHT.h>
#include <Wire.h>
#include <Adafruit_ADS1X15.h>
#include <OneWire.h>
#include <DallasTemperature.h>
#include <math.h>
#include "health_model.h"      // generated by export_model_to_c.py

#define FW_TAG "SINGLE-ESP32 REV B (edge AI + two-way control)"

// ===========================================================================
//  1. CONFIG — WiFi / MQTT broker
// ===========================================================================
const char* WIFI_SSID     = "YOUR_WIFI_SSID";
const char* WIFI_PASSWORD = "YOUR_WIFI_PASSWORD";

const char* MQTT_HOST     = "192.168.1.100";   // IP of the PC running Mosquitto
const int   MQTT_PORT     = 1883;
const char* MQTT_CLIENTID = "esp32_battery_monitor";

// ===========================================================================
//  2. PIN MAP
// ===========================================================================
#define DHT_PIN            2
#define ONE_WIRE_BUS       19
#define MOSFET_PWM_PIN     13
#define FAN_PWM_PIN        25   // moved here from gas (digital out — WiFi-safe)
#define CURRENT_PIN        35   // ADC1
#define PIEZO_1_PIN        36   // ADC1
#define PIEZO_2_PIN        39   // ADC1
#define GAS_PIN            34   // ADC1 — moved from GPIO25 (ADC2, unsafe w/ WiFi)

// ADS1115 on the ESP32's default I2C pins
#define ADS1115_I2C_ADDR  0x48
#define ADS1115_SDA       21
#define ADS1115_SCL       22
#define ADS_CH_TAP1        0
#define ADS_CH_TAP2        1
#define ADS_CH_TAP3        2
#define ADS_GAIN  GAIN_ONE      // +-4.096V; power ADS1115 VDD from 5V

// =============== DIVIDER FACTORS ===============
// Tap1: 100k/100k -> 2.0 | Tap2: 220k/100k -> 3.2 | Tap3: 330k/100k -> 4.3
#define TAP1_FACTOR  2.000f
#define TAP2_FACTOR  3.200f
#define TAP3_FACTOR  4.300f

#define ACS712_SENS_V_PER_A  0.066f   // 30A module (confirmed) = 66 mV/A
#define ACS712_DIV_RATIO     0.6875f  // 10k/22k divider. Set 1.0f if the ACS712
                                      // OUT goes straight to ADS1115 A3 (no divider)

// REV B: read the ACS712 through the ADS1115 instead of the ESP32 ADC.
// A 30A sensor on a 1-3A load only moves 66 mV per amp; the ESP32's own
// ADC is too noisy/non-linear for that. The ADS1115 is 16-bit (0.125 mV
// steps at GAIN_ONE) - about 16x finer. Wire ACS712 OUT -> ADS1115 A3
// (the ADS1115 runs from 5V, so the divider is optional), then set 1.
#define CURRENT_VIA_ADS      0
#define ADS_CH_CURRENT       3
// Fine-tune against a multimeter: run 2.0 A by the meter, read the ESP32's
// current, set TRIM = meter / ESP32 (e.g. 2.00 / 1.86 = 1.075)
#define CURRENT_GAIN_TRIM    1.000f

// =============== BATTERY / SAFETY CONSTANTS ===============
#define CELL_COUNT 3
#define PACK_CAPACITY_MAH  3700.0f
#define CELL_V_MAX          4.25f
#define CELL_V_MIN          2.80f
#define CELL_TEMP_MAX       55.0f
#define GAS_ALERT_LEVEL     2500

// Fan curve
const float FAN_TEMP_ON   = 35.0f;
const float FAN_TEMP_FULL = 55.0f;
const int   FAN_MIN_DUTY  = 60;     // bench-tune: lowest duty that spins your fan

// =============== TIMING ===============
#define SENSOR_INTERVAL_MS   1000
#define CONTROL_INTERVAL_MS   200
#define ADC_SAMPLES            64

// =============== PWM ===============
#define LOAD_PWM_FREQ   5000
#define LOAD_PWM_RES_BITS  10
#define LOAD_PWM_MAX     1023
#define FAN_PWM_FREQ    25000
#define FAN_PWM_RES_BITS   8
#define FAN_PWM_MAX      255

#define KP_CURRENT 40.0f
#define PWM_STEP_MAX 25

// ===========================================================================
//  3. THRESHOLDS
// ===========================================================================
const float TH_TEMP_WARN      = 45.0f;
const float TH_TEMP_CRIT      = CELL_TEMP_MAX;
const float TH_GRADIENT_WARN  = 5.0f;
const float TH_DTDT_WARN      = 0.20f;
const float TH_DTDT_CRIT      = 1.00f;

const float TH_CELL_UV_WARN   = 3.00f;
const float TH_CELL_UV_CRIT   = CELL_V_MIN;
const float TH_CELL_OV_WARN   = 4.20f;
const float TH_CELL_OV_CRIT   = CELL_V_MAX;
const float TH_IMBALANCE_WARN = 0.10f;
const float TH_IMBALANCE_CRIT = 0.20f;

const float TH_CURRENT_WARN   = 2.50f;
const float TH_CURRENT_CRIT   = 5.00f;

const float TH_SOC_LOW_WARN   = 15.0f;
const float TH_SOC_LOW_CRIT   = 5.0f;
const float TH_SOH_WARN       = 85.0f;
const float TH_SOH_CRIT       = 80.0f;

const int   TH_GAS_WARN       = 1800;
const int   TH_GAS_CRIT       = GAS_ALERT_LEVEL;

const float TH_RISK_WARN      = 50.0f;
const float TH_RISK_CRIT      = 80.0f;

// ===========================================================================
//  4. OBJECTS
// ===========================================================================
DHT dht(DHT_PIN, DHT11);
OneWire oneWire(ONE_WIRE_BUS);
DallasTemperature tempSensors(&oneWire);
Adafruit_ADS1115 ads;
bool ads_ok = false;

WiFiClient   net;
PubSubClient mqtt(net);

static StaticJsonDocument<2048> outDoc;
static char outBuf[2048];

// ===========================================================================
//  5. STATE
// ===========================================================================
struct BatteryState {
  float cell_temp[CELL_COUNT];
  float ambient_temp, ambient_humidity;
  float cell_voltage[CELL_COUNT];
  float pack_voltage;
  float current_A;
  float power_W;
  float soc_percent;
  float soh_percent;
  float rul_cycles;
  float piezo_raw[2];
  int   gas_level;
  float cell_imbalance;
  float thermal_gradient_C;
  float dT_dt;
  int   cycles_completed;
  bool  fault_ov, fault_uv, fault_ot, fault_gas;
  float r0_mohm;
  float dod_percent;
  float soe_percent, sof_percent, sop_percent;
  float continuous_current_limit_A;
  float peak_discharge_current_limit_A;
  float peak_charge_current_limit_A;
  float thermal_runaway_risk;
  float remaining_energy_Wh;
  float total_energy_throughput_Wh;
  float equivalent_full_cycles;
  float time_to_empty_min, time_to_full_min;
  int   target_current;
  int   pwm_duty;
  bool  bms_tripped;
} bat;

// Globals
float coulomb_mAh = 0.0f;
float cycle_discharge_mAh = 0.0f;
float baseline_capacity_mAh = PACK_CAPACITY_MAH;
float measured_capacity_mAh = PACK_CAPACITY_MAH;
float acs712_zero_volts = 2.5f;
float target_current_A = 0.0f;
int   pwm_duty = 0;
int   fan_duty = 0;
bool  safety_active = false;
char  safety_reason[64] = "";

float last_max_temp = 0.0f;
unsigned long last_temp_time = 0;
bool thermal_seeded = false;

float prev_current_A = 0.0f;
float prev_pack_voltage = 0.0f;
bool  r0_seeded = false;

unsigned long last_sensor_ms = 0;
unsigned long last_control_ms = 0;
unsigned long lastMqttTry = 0;
unsigned long lastStats = 0;

char        warnBuf[320];
int         statusLevel = 0;
const char* statusText  = "NORMAL";

char usb_cmd_buf[96];
uint8_t usb_cmd_len = 0;

// ---- REV B: two-way control ----
float current_limit_A = 5.0f;          // cap set by the digital twin (LIMIT:)
int   fan_override_pct = -1;           // -1 = automatic temperature curve
float sensor_dt_s = 1.0f;              // measured time between sensor passes
unsigned long prev_sensor_pass_ms = 0;

// ---- REV B: demo mode ----
bool  demo_mode = false;
unsigned long last_demo_msg_ms = 0;
#define DEMO_TIMEOUT_MS 30000UL

// ---- REV B: edge AI (one discharge being averaged) ----
#define AI_DISCHARGE_A      0.3f
#define AI_QUIET_READINGS   3
#define AI_MIN_REAL_MS      300000UL   // real pack: 5 minutes
#define AI_MIN_REPLAY_MS    4000UL     // replayed lab cycles are compressed
struct Discharge {
  bool active = false;
  bool replay = false;
  unsigned long start_ms = 0;
  int quiet = 0;
  double sum_v = 0;  long n_v = 0;
  double sum_t = 0;  long n_t = 0;
  float cycles = 0;
} dis;
unsigned long ai_results = 0;
float last_ai_soh = -1.0f;

// ===========================================================================
//  6. LOW-LEVEL HELPERS
// ===========================================================================
void setLoadPwm(int duty) { ledcWrite(MOSFET_PWM_PIN, duty); }

float readPinVolts(int pin) {
  uint32_t acc = 0;
  for (int i = 0; i < ADC_SAMPLES; i++) acc += analogRead(pin);
  float raw = (float)acc / ADC_SAMPLES;
  return (raw / 4095.0f) * 3.3f;
}

int readPinRaw(int pin) {
  uint32_t acc = 0;
  for (int i = 0; i < ADC_SAMPLES; i++) acc += analogRead(pin);
  return (int)(acc / ADC_SAMPLES);
}

float readAdsVolts(uint8_t channel) {
  if (!ads_ok) return 0.0f;
  int32_t acc = 0;
  const int N = 8;
  for (int i = 0; i < N; i++) acc += ads.readADC_SingleEnded(channel);
  int16_t avgRaw = (int16_t)(acc / N);
  return ads.computeVolts(avgRaw);
}

// ===========================================================================
//  7. SENSOR READS (kept phase-isolated — see header note)
// ===========================================================================
void readTemperaturesALONE() {
  tempSensors.requestTemperatures();
  for (int i = 0; i < CELL_COUNT; i++) {
    float t = tempSensors.getTempCByIndex(i);
    if (t != DEVICE_DISCONNECTED_C && t > -50 && t < 150 && t != 85.0f) {
      bat.cell_temp[i] = t;
    }
  }
  delay(200);  // let the OneWire bus / supply rail settle before any ADC read
}

float readCurrentSensorVolts() {
#if CURRENT_VIA_ADS
  return readAdsVolts(ADS_CH_CURRENT) / ACS712_DIV_RATIO;   // REV B: 16-bit path
#else
  return readPinVolts(CURRENT_PIN) / ACS712_DIV_RATIO;
#endif
}

void readCurrentALONE() {
  float v_sensor = readCurrentSensorVolts();
  bat.current_A = (v_sensor - acs712_zero_volts) / ACS712_SENS_V_PER_A * CURRENT_GAIN_TRIM;
  if (fabs(bat.current_A) < 0.05f) bat.current_A = 0.0f;
}

void readAmbient() {
  float t = dht.readTemperature();
  float h = dht.readHumidity();
  if (!isnan(t)) bat.ambient_temp = t;
  if (!isnan(h)) bat.ambient_humidity = h;
}

void readCellVoltages() {
  float v1 = readAdsVolts(ADS_CH_TAP1) * TAP1_FACTOR;
  float v2 = readAdsVolts(ADS_CH_TAP2) * TAP2_FACTOR;
  float v3 = readAdsVolts(ADS_CH_TAP3) * TAP3_FACTOR;
  bat.cell_voltage[0] = v1;
  bat.cell_voltage[1] = v2 - v1;
  bat.cell_voltage[2] = v3 - v2;
  bat.pack_voltage = v3;
}

void readPiezo() {
  bat.piezo_raw[0] = readPinRaw(PIEZO_1_PIN);
  bat.piezo_raw[1] = readPinRaw(PIEZO_2_PIN);
}

void readGas() {
  bat.gas_level = readPinRaw(GAS_PIN);
}

void calibrateCurrentZero() {
  pwm_duty = 0;
  setLoadPwm(0);
  delay(500);
  float sum = 0;
  for (int i = 0; i < 20; i++) {
    sum += readCurrentSensorVolts();
    delay(20);
  }
  acs712_zero_volts = sum / 20.0f;
}

// ===========================================================================
//  8. FAN CONTROL
// ===========================================================================
void updateFan(float tmax) {
  if (fan_override_pct >= 0) {                       // REV B: twin / user override
    fan_duty = (int)(fan_override_pct / 100.0f * FAN_PWM_MAX);
    ledcWrite(FAN_PWM_PIN, fan_duty);
    return;
  }
  if (tmax <= FAN_TEMP_ON) {
    fan_duty = 0;
  } else if (tmax >= FAN_TEMP_FULL) {
    fan_duty = FAN_PWM_MAX;
  } else {
    float frac = (tmax - FAN_TEMP_ON) / (FAN_TEMP_FULL - FAN_TEMP_ON);
    fan_duty = FAN_MIN_DUTY + (int)(frac * (FAN_PWM_MAX - FAN_MIN_DUTY));
  }
  ledcWrite(FAN_PWM_PIN, fan_duty);
}

// ===========================================================================
//  9. CALCULATIONS
// ===========================================================================
void updateCoulombCount() {
  float hours = sensor_dt_s / 3600.0f;          // REV B: measured, not assumed
  float mAh = bat.current_A * 1000.0f * hours;
  coulomb_mAh += mAh;
  if (mAh < 0) cycle_discharge_mAh += -mAh;
}

void calculateSOC() {
  float soc = 100.0f + ((coulomb_mAh / PACK_CAPACITY_MAH) * 100.0f);
  bat.soc_percent = constrain(soc, 0.0f, 100.0f);
  bat.dod_percent = 100.0f - bat.soc_percent;
}

void calculateSOH() {
  bat.soh_percent = constrain((measured_capacity_mAh / baseline_capacity_mAh) * 100.0f, 0.0f, 100.0f);
}

void calculateRUL() {
  float remaining = bat.soh_percent - 80.0f;
  bat.rul_cycles = (remaining <= 0.0f) ? 0.0f : (remaining / 0.05f);
}

void calculateR0() {
  float dI = bat.current_A - prev_current_A;
  if (r0_seeded && fabs(dI) > 0.15f) {
    float dV = bat.pack_voltage - prev_pack_voltage;
    float r0_sample_mohm = fabs((dV / dI) * 1000.0f);
    if (r0_sample_mohm < 2000.0f) {
      if (bat.r0_mohm <= 0.01f) bat.r0_mohm = r0_sample_mohm;
      else bat.r0_mohm = (0.8f * bat.r0_mohm) + (0.2f * r0_sample_mohm);
    }
  }
  prev_current_A = bat.current_A;
  prev_pack_voltage = bat.pack_voltage;
  r0_seeded = true;
}

void calculateDerived() {
  bat.power_W = bat.pack_voltage * fabs(bat.current_A);

  float vmax = bat.cell_voltage[0], vmin = bat.cell_voltage[0];
  float tmax = bat.cell_temp[0], tmin = bat.cell_temp[0];
  for (int i = 1; i < CELL_COUNT; i++) {
    vmax = max(vmax, bat.cell_voltage[i]);
    vmin = min(vmin, bat.cell_voltage[i]);
    tmax = max(tmax, bat.cell_temp[i]);
    tmin = min(tmin, bat.cell_temp[i]);
  }
  bat.cell_imbalance = vmax - vmin;
  bat.thermal_gradient_C = tmax - tmin;

  unsigned long now = millis();
  if (!thermal_seeded) {
    last_max_temp = tmax;
    last_temp_time = now;
    bat.dT_dt = 0.0f;
    thermal_seeded = true;
  } else {
    float dt_s = (now - last_temp_time) / 1000.0f;
    if (dt_s > 0.5f) {
      bat.dT_dt = (tmax - last_max_temp) / dt_s;
      last_max_temp = tmax;
      last_temp_time = now;
    }
  }

  bat.thermal_runaway_risk = 0.0f;
  if (tmax > 45.0f) bat.thermal_runaway_risk += ((tmax - 45.0f) / 15.0f) * 45.0f;
  if (bat.dT_dt > 0.2f) bat.thermal_runaway_risk += ((bat.dT_dt - 0.2f) / 0.8f) * 30.0f;
  if (bat.thermal_gradient_C > 8.0f) bat.thermal_runaway_risk += 15.0f;
  if (bat.cell_imbalance > 0.1f) bat.thermal_runaway_risk += 5.0f;
  if (bat.gas_level > GAS_ALERT_LEVEL) bat.thermal_runaway_risk += 20.0f;
  bat.thermal_runaway_risk = constrain(bat.thermal_runaway_risk, 0.0f, 100.0f);

  float thermal_factor = 1.0f;
  if (tmax > 45.0f) thermal_factor = 1.0f - ((tmax - 45.0f) / 10.0f);
  thermal_factor = constrain(thermal_factor, 0.0f, 1.0f);

  float health_factor = bat.soh_percent / 100.0f;
  bat.continuous_current_limit_A = 2.50f * thermal_factor * health_factor;
  bat.peak_discharge_current_limit_A = 5.00f * thermal_factor * health_factor;
  bat.peak_charge_current_limit_A = 1.25f * thermal_factor * health_factor;

  float nominal_energy = 11.1f * (PACK_CAPACITY_MAH / 1000.0f);
  bat.remaining_energy_Wh = nominal_energy * (bat.soc_percent / 100.0f) * (bat.soh_percent / 100.0f);
  bat.soe_percent = (bat.remaining_energy_Wh / nominal_energy) * 100.0f;
  bat.sof_percent = min(bat.soh_percent, bat.soe_percent);
  bat.sop_percent = bat.continuous_current_limit_A > 0
    ? min(100.0f, (bat.continuous_current_limit_A / fabs(target_current_A + 0.001f)) * 100.0f)
    : 100.0f;

  if (fabs(bat.current_A) > 0.05f) {
    float remaining_Ah = (bat.soc_percent / 100.0f) * (PACK_CAPACITY_MAH / 1000.0f);
    bat.time_to_empty_min = (remaining_Ah / fabs(bat.current_A)) * 60.0f;
    remaining_Ah = ((100.0f - bat.soc_percent) / 100.0f) * (PACK_CAPACITY_MAH / 1000.0f);
    bat.time_to_full_min = (remaining_Ah / fabs(bat.current_A)) * 60.0f;
  } else {
    bat.time_to_empty_min = -1.0f;
    bat.time_to_full_min = -1.0f;
  }

  float hours = sensor_dt_s / 3600.0f;          // REV B: measured, not assumed
  bat.total_energy_throughput_Wh += bat.power_W * hours;
  bat.equivalent_full_cycles = bat.total_energy_throughput_Wh / (2.0f * 11.1f * (PACK_CAPACITY_MAH / 1000.0f));
}

void checkFaults() {
  bat.fault_ov = false;
  bat.fault_uv = false;
  bat.fault_ot = false;
  for (int i = 0; i < CELL_COUNT; i++) {
    if (bat.cell_voltage[i] > CELL_V_MAX) bat.fault_ov = true;
    if (bat.cell_voltage[i] < CELL_V_MIN && bat.cell_voltage[i] > 0.5f) bat.fault_uv = true;
    if (bat.cell_temp[i] > CELL_TEMP_MAX) bat.fault_ot = true;
  }
  bat.fault_gas = (bat.gas_level > GAS_ALERT_LEVEL);
  bat.bms_tripped = bat.fault_ov || bat.fault_uv || bat.fault_ot || bat.fault_gas;
}

// ===========================================================================
//  10. SAFETY CUTOFF — direct and immediate (same chip sees temp AND PWM)
// ===========================================================================
void checkSafetyCutoff() {
  safety_active = false;

  for (int i = 0; i < CELL_COUNT; i++) {
    if (bat.cell_voltage[i] < CELL_V_MIN && bat.cell_voltage[i] > 0.5f) {
      safety_active = true;
      snprintf(safety_reason, sizeof(safety_reason), "cell%d undervoltage %.2f V", i + 1, bat.cell_voltage[i]);
    }
    if (bat.cell_voltage[i] > CELL_V_MAX) {
      safety_active = true;
      snprintf(safety_reason, sizeof(safety_reason), "cell%d overvoltage %.2f V", i + 1, bat.cell_voltage[i]);
    }
    if (bat.cell_temp[i] > CELL_TEMP_MAX) {
      safety_active = true;
      snprintf(safety_reason, sizeof(safety_reason), "cell%d overtemp %.1f C", i + 1, bat.cell_temp[i]);
    }
  }
  if (bat.gas_level > GAS_ALERT_LEVEL) {
    safety_active = true;
    snprintf(safety_reason, sizeof(safety_reason), "gas level %d > %d", bat.gas_level, GAS_ALERT_LEVEL);
  }
  if (bat.dT_dt > TH_DTDT_CRIT) {
    safety_active = true;
    snprintf(safety_reason, sizeof(safety_reason), "dT/dt %.2f C/s", bat.dT_dt);
  }

  if (safety_active) {
    target_current_A = 0.0f;
    pwm_duty = 0;
    setLoadPwm(0);
  }
}

// ===========================================================================
//  11. LOAD CONTROL
// ===========================================================================
void runCurrentControl() {
  // REV B: the digital twin can cap the current (LIMIT:), demo mode forces 0
  float goal = min(target_current_A, current_limit_A);
  if (demo_mode) goal = 0.0f;
  if (goal <= 0.0f) {
    pwm_duty = 0;
    setLoadPwm(0);
    bat.pwm_duty = 0;
    bat.target_current = 0;
    return;
  }

  float actual = fabs(bat.current_A);
  float error = goal - actual;
  int correction = (int)(error * KP_CURRENT);
  correction = constrain(correction, -PWM_STEP_MAX, PWM_STEP_MAX);

  pwm_duty = constrain(pwm_duty + correction, 0, LOAD_PWM_MAX);
  setLoadPwm(pwm_duty);
  bat.pwm_duty = pwm_duty;
  bat.target_current = (int)target_current_A;
}

// REV B: SOC from resting cell voltage (same curve as battery_model.py)
float socFromOcv(float v) {
  const float S[] = {0.00,0.05,0.10,0.15,0.20,0.30,0.40,0.50,0.60,0.70,0.80,0.90,0.95,1.00};
  const float V[] = {3.00,3.35,3.45,3.51,3.55,3.62,3.68,3.74,3.82,3.90,3.99,4.09,4.15,4.20};
  if (v <= V[0]) return 0.0f;
  for (int i = 0; i < 13; i++)
    if (v <= V[i + 1]) return S[i] + (S[i + 1] - S[i]) * (v - V[i]) / (V[i + 1] - V[i]);
  return 1.0f;
}

// ===========================================================================
//  12. COMMANDS — LOAD / STOP / CAL / ZERO / CYCLE, all local now
// ===========================================================================
void handleCommand(String cmd, const char* src) {
  cmd.trim();
  if (cmd.length() == 0) return;
  cmd.toUpperCase();

  Serial.printf("\n>>> CMD from %s: '%s'\n", src, cmd.c_str());

  if (cmd.startsWith("LOAD:")) {
    float amps = cmd.substring(5).toFloat();
    target_current_A = constrain(amps, 0.0f, 5.0f);
    Serial.printf("Target current set to %.2f A\n", target_current_A);
    if (target_current_A > 0.0f && safety_active) {
      Serial.printf("Safety cutoff active: %s -> load forced to 0 A\n", safety_reason);
    }
  }
  else if (cmd.startsWith("STOP")) {
    target_current_A = 0.0f;
    Serial.println(F("Load stopped"));
  }
  else if (cmd.startsWith("CAL")) {
    target_current_A = 0.0f;
    calibrateCurrentZero();
    Serial.printf("ACS712 calibrated: zero = %.4f V\n", acs712_zero_volts);
  }
  else if (cmd.startsWith("ZERO")) {
    coulomb_mAh = 0.0f;
    Serial.println(F("SOC reset to 100%"));
  }
  else if (cmd.startsWith("LIMIT:")) {                 // REV B: twin current cap
    String v = cmd.substring(6);
    if (v == "OFF") current_limit_A = 5.0f;
    else current_limit_A = constrain(v.toFloat(), 0.0f, 5.0f);
    Serial.printf("Current limit now %.2f A%s\n", current_limit_A,
                  current_limit_A >= 5.0f ? " (no limit)" : " - set by digital twin");
  }
  else if (cmd.startsWith("FAN:")) {                   // REV B: fan override
    String v = cmd.substring(4);
    if (v == "AUTO") fan_override_pct = -1;
    else fan_override_pct = constrain((int)v.toFloat(), 0, 100);
    Serial.printf("Fan: %s\n", fan_override_pct < 0 ? "automatic" : String(fan_override_pct).c_str());
  }
  else if (cmd.startsWith("SYNC")) {                   // REV B: SOC from OCV at rest
    float vcell = bat.pack_voltage / CELL_COUNT;
    if (fabs(bat.current_A) < 0.1f && vcell > 2.5f) {
      float soc = socFromOcv(vcell);
      coulomb_mAh = (soc - 1.0f) * PACK_CAPACITY_MAH;
      Serial.printf("SOC synced from %.3f V/cell -> %.1f%%\n", vcell, soc * 100.0f);
    } else {
      Serial.println(F("SYNC needs the pack at rest (no load)"));
    }
  }
  else if (cmd.startsWith("DEMO_ON")) {                // REV B: on-chip AI on replay
    if (!demo_mode) {
      demo_mode = true;
      target_current_A = 0.0f;
      last_demo_msg_ms = millis();
      dis = Discharge();
      if (mqtt.connected()) mqtt.subscribe("battery/state");
      Serial.println(F("DEMO MODE ON - not publishing own readings, AI listens to the laptop"));
    }
  }
  else if (cmd.startsWith("DEMO_OFF")) {
    if (demo_mode) {
      demo_mode = false;
      dis = Discharge();
      // anything the SIMULATED twin set during the demo must not stick
      current_limit_A = 5.0f;
      fan_override_pct = -1;
      if (mqtt.connected()) mqtt.unsubscribe("battery/state");
      Serial.println(F("DEMO MODE OFF - publishing own readings again"));
    }
  }
  else if (cmd.startsWith("CYCLE")) {
    if (cycle_discharge_mAh > 100.0f) {
      measured_capacity_mAh = cycle_discharge_mAh;
      if (bat.cycles_completed == 0) baseline_capacity_mAh = cycle_discharge_mAh;
      bat.cycles_completed++;
      Serial.printf("Cycle %d complete, capacity %.1f mAh\n", bat.cycles_completed, measured_capacity_mAh);
    }
    cycle_discharge_mAh = 0.0f;
  }
}

void pollUsb() {
  while (Serial.available()) {
    char c = (char)Serial.read();
    if (c == '\n' || c == '\r') {
      if (usb_cmd_len > 0) {
        usb_cmd_buf[usb_cmd_len] = '\0';
        handleCommand(String(usb_cmd_buf), "USB");
        usb_cmd_len = 0;
      }
    } else if (usb_cmd_len < 95) {
      usb_cmd_buf[usb_cmd_len++] = c;
    } else {
      usb_cmd_len = 0;
    }
  }
}

// ===========================================================================
//  13. THRESHOLD ENGINE
// ===========================================================================
static inline void escalate(int lvl) { if (lvl > statusLevel) statusLevel = lvl; }
void addWarn(const char* w) {
  if (warnBuf[0] != '\0') strncat(warnBuf, ",", sizeof(warnBuf) - strlen(warnBuf) - 1);
  strncat(warnBuf, w, sizeof(warnBuf) - strlen(warnBuf) - 1);
}
void flag(int lvl, const char* tag) { escalate(lvl); addWarn(tag); }

void checkThresholds() {
  statusLevel = 0;
  warnBuf[0]  = '\0';

  const char* tTags[3] = { "TEMP_C1", "TEMP_C2", "TEMP_C3" };
  for (int i = 0; i < CELL_COUNT; i++) {
    float t = bat.cell_temp[i];
    if (t < -50.0f || t > 200.0f) continue;
    if      (t >= TH_TEMP_CRIT) flag(2, tTags[i]);
    else if (t >= TH_TEMP_WARN) flag(1, tTags[i]);
  }
  if (bat.thermal_gradient_C > TH_GRADIENT_WARN) flag(1, "TEMP_GRADIENT");
  if      (bat.dT_dt >= TH_DTDT_CRIT) flag(2, "DTDT_RUNAWAY");
  else if (bat.dT_dt >= TH_DTDT_WARN) flag(1, "DTDT_RISING");

  const char* vTagU[3] = { "UV_C1", "UV_C2", "UV_C3" };
  const char* vTagO[3] = { "OV_C1", "OV_C2", "OV_C3" };
  for (int i = 0; i < CELL_COUNT; i++) {
    float v = bat.cell_voltage[i];
    if (v < 0.5f) continue;
    if      (v <= TH_CELL_UV_CRIT) flag(2, vTagU[i]);
    else if (v <= TH_CELL_UV_WARN) flag(1, vTagU[i]);
    if      (v >= TH_CELL_OV_CRIT) flag(2, vTagO[i]);
    else if (v >= TH_CELL_OV_WARN) flag(1, vTagO[i]);
  }
  if      (bat.cell_imbalance >= TH_IMBALANCE_CRIT) flag(2, "IMBALANCE");
  else if (bat.cell_imbalance >= TH_IMBALANCE_WARN) flag(1, "IMBALANCE");

  float ic = fabs(bat.current_A);
  if      (ic >= TH_CURRENT_CRIT) flag(2, "OVERCURRENT");
  else if (ic >= TH_CURRENT_WARN) flag(1, "HIGH_CURRENT");

  if      (bat.soc_percent <= TH_SOC_LOW_CRIT) flag(2, "SOC_EMPTY");
  else if (bat.soc_percent <= TH_SOC_LOW_WARN) flag(1, "SOC_LOW");
  if      (bat.soh_percent < TH_SOH_CRIT) flag(2, "SOH_EOL");
  else if (bat.soh_percent < TH_SOH_WARN) flag(1, "SOH_DEGRADED");

  if      (bat.gas_level >= TH_GAS_CRIT) flag(2, "GAS_CRITICAL");
  else if (bat.gas_level >= TH_GAS_WARN) flag(1, "GAS_ELEVATED");

  if      (bat.thermal_runaway_risk >= TH_RISK_CRIT) flag(2, "RUNAWAY_RISK");
  else if (bat.thermal_runaway_risk >= TH_RISK_WARN) flag(1, "RISK_ELEVATED");

  if (bat.bms_tripped) flag(2, "BMS_TRIPPED");
  if (bat.fault_ov)    flag(2, "FAULT_OV");
  if (bat.fault_uv)    flag(2, "FAULT_UV");
  if (bat.fault_ot)    flag(2, "FAULT_OT");
  if (bat.fault_gas)   flag(2, "FAULT_GAS");

  statusText = (statusLevel == 2) ? "CRITICAL" : (statusLevel == 1) ? "WARNING" : "NORMAL";
  if (warnBuf[0] == '\0') strcpy(warnBuf, "NONE");
}

// ===========================================================================
//  13b. EDGE AI (REV B) - same rules as health_inference.py on the laptop
// ===========================================================================
void aiFinishDischarge() {
  unsigned long dur = millis() - dis.start_ms;
  unsigned long needed = dis.replay ? AI_MIN_REPLAY_MS : AI_MIN_REAL_MS;
  dis.active = false;
  if (dur < needed || dis.n_v < 3 || dis.n_t < 3) {
    Serial.printf("[EDGE AI] discharge of %lu s ignored (needs %lu s)\n",
                  dur / 1000, needed / 1000);
    return;
  }
  float values[3] = { (float)(dis.sum_v / dis.n_v), (float)(dis.sum_t / dis.n_t),
                      dis.cycles + 1.0f };
  const char* names[3] = {"voltage", "temperature", "cycle"};
  float x[HM_N_FEATURES];
  for (int j = 0; j < 3; j++) {
    int k = hm_feature_index(names[j]);
    if (k >= 0) x[k] = values[j];
  }
  unsigned long t0 = micros();
  float est = hm_predict(x);
  unsigned long t1 = micros();
  float phi[HM_N_FEATURES], base;
  hm_shap(x, phi, &base);
  unsigned long t2 = micros();

  int in_range = 1;
  for (int j = 0; j < HM_N_FEATURES; j++)
    if (x[j] < HM_RANGE_LO[j] || x[j] > HM_RANGE_HI[j]) in_range = 0;
  int iv = hm_feature_index("voltage"), it = hm_feature_index("temperature"),
      ic = hm_feature_index("cycle");

  char buf[512];
  snprintf(buf, sizeof(buf),
    "{\"est_soh\":%.2f,\"base_soh\":%.2f,"
    "\"shap_voltage\":%.2f,\"shap_temperature\":%.2f,\"shap_cycle\":%.2f,"
    "\"feat_voltage\":%.4f,\"feat_temperature\":%.2f,\"cycle\":%d,"
    "\"infer_us\":%lu,\"explain_ms\":%.1f,\"in_range\":%d,"
    "\"uncertainty_pct\":%.1f,\"source\":\"%s\",\"device\":\"ESP32\"}",
    est * 100.0f, base * 100.0f,
    iv >= 0 ? phi[iv] * 100.0f : 0.0f, it >= 0 ? phi[it] * 100.0f : 0.0f,
    ic >= 0 ? phi[ic] * 100.0f : 0.0f,
    values[0], values[1], (int)values[2],
    t1 - t0, (t2 - t1) / 1000.0f, in_range,
    HM_UNCERTAINTY_PCT, dis.replay ? "replay" : "live");
  if (mqtt.connected()) mqtt.publish("battery/ai_edge", buf, true);
  ai_results++;
  last_ai_soh = est * 100.0f;
  Serial.printf("[EDGE AI] cycle %d: health %.1f%% | estimate %lu us, explanation %.1f ms%s\n",
                (int)values[2], est * 100.0f, t1 - t0, (t2 - t1) / 1000.0f,
                in_range ? "" : " | INPUT OUTSIDE TRAINING RANGE");
}

// One reading into the current discharge. current < 0 = discharging.
void aiAccumulate(float current, float vcell, float tcell, float cycles, bool replay) {
  if (current < -AI_DISCHARGE_A) {
    if (!dis.active) {
      dis = Discharge();
      dis.active = true;
      dis.replay = replay;
      dis.start_ms = millis();
    }
    dis.quiet = 0;
    if (!isnan(vcell)) { dis.sum_v += vcell; dis.n_v++; }
    if (!isnan(tcell)) { dis.sum_t += tcell; dis.n_t++; }
    dis.cycles = cycles;
  } else if (dis.active) {
    if (++dis.quiet >= AI_QUIET_READINGS) aiFinishDischarge();
  }
}

float meanCellVoltage(float c1, float c2, float c3, float pack) {
  float c[3] = {c1, c2, c3};
  float sum = 0; int n = 0;
  for (int i = 0; i < 3; i++) if (c[i] > 2.0f && c[i] < 4.5f) { sum += c[i]; n++; }
  if (n == 3) return sum / 3.0f;
  if (pack > 6.0f && pack < 13.5f) return pack / 3.0f;
  return NAN;
}

float meanCellTemp(float t1, float t2, float t3) {
  float t[3] = {t1, t2, t3};
  float sum = 0; int n = 0;
  for (int i = 0; i < 3; i++) if (t[i] > -40.0f && t[i] < 100.0f) { sum += t[i]; n++; }
  return n ? sum / n : NAN;
}

// Real pack: called once per sensor pass
void aiFeedLocal() {
  aiAccumulate(bat.current_A,
               meanCellVoltage(bat.cell_voltage[0], bat.cell_voltage[1],
                               bat.cell_voltage[2], bat.pack_voltage),
               meanCellTemp(bat.cell_temp[0], bat.cell_temp[1], bat.cell_temp[2]),
               (float)bat.cycles_completed, false);
}

// Demo: replayed NASA data arriving over MQTT
void aiFeedReplay(const String& json) {
  StaticJsonDocument<2048> d;
  if (deserializeJson(d, json)) return;
  const char* src = d["source"] | "";
  if (strcmp(src, "replay") != 0) return;           // only lab replay feeds the AI
  aiAccumulate(d["current_A"] | 0.0f,
               meanCellVoltage(d["cell1_voltage"] | 0.0f, d["cell2_voltage"] | 0.0f,
                               d["cell3_voltage"] | 0.0f, d["pack_voltage"] | 0.0f),
               meanCellTemp(d["cell1_temp"] | -999.0f, d["cell2_temp"] | -999.0f,
                            d["cell3_temp"] | -999.0f),
               d["cycles"] | 0.0f, true);
}

void aiSelfTest() {
  float x[HM_N_FEATURES];
  for (int j = 0; j < HM_N_FEATURES; j++) x[j] = HM_BG[j];   // a new cell
  unsigned long t0 = micros();
  float est = hm_predict(x);
  unsigned long dt = micros() - t0;
  Serial.printf("AI model: %s, %d trees, compiled into this firmware\n", HM_BACKEND, HM_N_TREES);
  Serial.printf("AI self-test: new-cell estimate %.1f%% in %lu us\n", est * 100.0f, dt);
}

// ===========================================================================
//  14. WIFI / MQTT
// ===========================================================================
void connectWiFi() {
  if (WiFi.status() == WL_CONNECTED) return;

  Serial.printf("[WiFi] connecting to '%s'", WIFI_SSID);
  WiFi.mode(WIFI_STA);
  WiFi.begin(WIFI_SSID, WIFI_PASSWORD);

  for (int i = 0; i < 40 && WiFi.status() != WL_CONNECTED; i++) {
    delay(250);
    Serial.print('.');
  }

  if (WiFi.status() == WL_CONNECTED)
    Serial.printf("\n[WiFi] connected, IP %s\n", WiFi.localIP().toString().c_str());
  else
    Serial.println(F("\n[WiFi] failed — will retry"));
}

void onMqttMessage(char* topic, byte* payload, unsigned int len) {
  String msg;
  msg.reserve(len);
  for (unsigned int i = 0; i < len; i++) msg += (char)payload[i];
  msg.trim();

  // REV B: in demo mode we do not publish battery/state ourselves, so
  // anything arriving on it comes from the laptop (replay / simulator)
  if (!strcmp(topic, "battery/state")) {
    if (demo_mode) {
      last_demo_msg_ms = millis();
      aiFeedReplay(msg);
    }
    return;
  }

  if (!strcmp(topic, "battery/cmd/load")) {
    char cmd[32];
    snprintf(cmd, sizeof(cmd), "LOAD:%s", msg.c_str());
    handleCommand(String(cmd), "MQTT");
    return;
  }
  if (!strcmp(topic, "battery/cmd/sys")) {
    handleCommand(msg, "MQTT");
  }
}

void connectMqtt() {
  if (mqtt.connected() || WiFi.status() != WL_CONNECTED) return;
  if (millis() - lastMqttTry < 5000) return;
  lastMqttTry = millis();

  Serial.printf("[MQTT] connecting to %s:%d ...", MQTT_HOST, MQTT_PORT);

  if (mqtt.connect(MQTT_CLIENTID, NULL, NULL, "battery/online", 0, true, "0")) {
    Serial.println(F(" connected"));
    mqtt.publish("battery/online", "1", true);
    mqtt.subscribe("battery/cmd/load");
    mqtt.subscribe("battery/cmd/sys");
    if (demo_mode) mqtt.subscribe("battery/state");    // REV B
    Serial.println(F("[MQTT] subscribed to command topics"));
  } else {
    Serial.printf(" failed rc=%d — will retry\n", mqtt.state());
  }
}

// ===========================================================================
//  15. PUBLISH
// ===========================================================================
void buildOutDoc() {
  outDoc.clear();
  outDoc["cell1_temp"] = bat.cell_temp[0];
  outDoc["cell2_temp"] = bat.cell_temp[1];
  outDoc["cell3_temp"] = bat.cell_temp[2];
  outDoc["ambient_temp"] = bat.ambient_temp;
  outDoc["ambient_humidity"] = bat.ambient_humidity;
  outDoc["cell1_voltage"] = bat.cell_voltage[0];
  outDoc["cell2_voltage"] = bat.cell_voltage[1];
  outDoc["cell3_voltage"] = bat.cell_voltage[2];
  outDoc["pack_voltage"] = bat.pack_voltage;
  outDoc["current_A"] = bat.current_A;
  outDoc["power_W"] = bat.power_W;
  outDoc["soc_percent"] = bat.soc_percent;
  outDoc["soh_percent"] = bat.soh_percent;
  outDoc["piezo1_raw"] = bat.piezo_raw[0];
  outDoc["piezo2_raw"] = bat.piezo_raw[1];
  outDoc["gas_level"] = bat.gas_level;
  outDoc["cell_imbalance"] = bat.cell_imbalance;
  outDoc["temp_gradient"] = bat.thermal_gradient_C;
  outDoc["dT_dt"] = bat.dT_dt;
  outDoc["cycles"] = bat.cycles_completed;
  outDoc["target_current"] = target_current_A;
  outDoc["pwm_duty"] = pwm_duty;
  outDoc["fan_duty"] = fan_duty;
  outDoc["bms_tripped"] = bat.bms_tripped ? 1 : 0;
  outDoc["fault_ov"] = bat.fault_ov ? 1 : 0;
  outDoc["fault_uv"] = bat.fault_uv ? 1 : 0;
  outDoc["fault_ot"] = bat.fault_ot ? 1 : 0;
  outDoc["fault_gas"] = bat.fault_gas ? 1 : 0;
  outDoc["dod_percent"] = bat.dod_percent;
  outDoc["soe_percent"] = bat.soe_percent;
  outDoc["sof_percent"] = bat.sof_percent;
  outDoc["sop_percent"] = bat.sop_percent;
  outDoc["rul_cycles"] = bat.rul_cycles;
  outDoc["continuous_current_limit_A"] = bat.continuous_current_limit_A;
  outDoc["peak_discharge_current_limit_A"] = bat.peak_discharge_current_limit_A;
  outDoc["peak_charge_current_limit_A"] = bat.peak_charge_current_limit_A;
  outDoc["thermal_gradient_C"] = bat.thermal_gradient_C;
  outDoc["thermal_runaway_risk"] = bat.thermal_runaway_risk;
  outDoc["internal_resistance_mohm"] = bat.r0_mohm;
  outDoc["remaining_energy_Wh"] = bat.remaining_energy_Wh;
  outDoc["total_energy_throughput_Wh"] = bat.total_energy_throughput_Wh;
  outDoc["equivalent_full_cycles"] = bat.equivalent_full_cycles;
  outDoc["time_to_empty_min"] = bat.time_to_empty_min;
  outDoc["time_to_full_min"] = bat.time_to_full_min;
  outDoc["system_status"] = statusText;
  outDoc["status_level"] = statusLevel;
  outDoc["warnings"] = warnBuf;
  // REV B
  outDoc["safety_active"] = safety_active ? 1 : 0;
  outDoc["safety_reason"] = safety_reason;
  outDoc["current_limit_A"] = current_limit_A;
  outDoc["fan_mode"] = fan_override_pct < 0 ? "auto" : "manual";
  outDoc["demo_mode"] = demo_mode ? 1 : 0;
  if (last_ai_soh >= 0) outDoc["edge_ai_soh"] = last_ai_soh;
}

void publishState() {
  if (!mqtt.connected()) return;   // skip publish only — calc/print already happened
  if (demo_mode) return;           // REV B: the laptop's replay owns battery/state now

  size_t n = serializeJson(outDoc, outBuf, sizeof(outBuf));
  if (n == 0 || n >= sizeof(outBuf)) {
    Serial.println(F("[MQTT] serialize overflow — state not sent"));
    return;
  }
  if (!mqtt.publish("battery/state", outBuf, true)) {
    Serial.printf("[MQTT] state publish FAILED (%u bytes)\n", (unsigned)n);
    return;
  }

  mqtt.publish("battery/alert/status",   statusText, true);
  mqtt.publish("battery/alert/level",    String(statusLevel).c_str(), true);
  mqtt.publish("battery/alert/warnings", warnBuf, true);
  mqtt.publish("battery/pack_voltage", String(bat.pack_voltage, 3).c_str());
  mqtt.publish("battery/current_A",    String(bat.current_A, 3).c_str());
  mqtt.publish("battery/soc_percent",  String(bat.soc_percent, 1).c_str());
  mqtt.publish("battery/soh_percent",  String(bat.soh_percent, 1).c_str());
  mqtt.publish("battery/temp/cell1",   String(bat.cell_temp[0], 2).c_str());
  mqtt.publish("battery/temp/cell2",   String(bat.cell_temp[1], 2).c_str());
  mqtt.publish("battery/temp/cell3",   String(bat.cell_temp[2], 2).c_str());
  mqtt.publish("battery/fan_duty",     String(fan_duty).c_str());
}

// ===========================================================================
//  16. PRINT — unconditional, every second, regardless of MQTT state
// ===========================================================================
void printState() {
  Serial.println(F("\n================ BATTERY STATE ================"));
  Serial.printf("TEMP: %.1f %.1f %.1f C | Ambient %.1f C / %.1f %%RH\n",
                bat.cell_temp[0], bat.cell_temp[1], bat.cell_temp[2], bat.ambient_temp, bat.ambient_humidity);
  Serial.printf("V: %.3f %.3f %.3f | PACK %.3f V\n", bat.cell_voltage[0], bat.cell_voltage[1], bat.cell_voltage[2], bat.pack_voltage);
  Serial.printf("I: %.3f A | Target %.2f A | Load PWM %d | Fan PWM %d/%d\n",
                bat.current_A, target_current_A, pwm_duty, fan_duty, FAN_PWM_MAX);
  Serial.printf("SOC %.1f%% | SOH %.1f%% | RUL %.1f cycles\n", bat.soc_percent, bat.soh_percent, bat.rul_cycles);
  Serial.printf("SOE %.1f%% | SOF %.1f%% | SOP %.1f%%\n", bat.soe_percent, bat.sof_percent, bat.sop_percent);
  Serial.printf("R0 %.1f mOhm | Imbalance %.3f V | Thermal gradient %.2f C\n", bat.r0_mohm, bat.cell_imbalance, bat.thermal_gradient_C);
  Serial.printf("Thermal risk %.1f/100 | dT/dt %.3f C/s\n", bat.thermal_runaway_risk, bat.dT_dt);
  Serial.printf("Piezo: %d %d | Gas: %d\n", (int)bat.piezo_raw[0], (int)bat.piezo_raw[1], bat.gas_level);
  Serial.printf("Status: %s | Warnings: %s\n", statusText, warnBuf);
  if (safety_active) Serial.printf("SAFETY CUTOFF ACTIVE: %s\n", safety_reason);
  if (!ads_ok) Serial.println(F("WARNING: ADS1115 not detected — voltages are stale/zero"));
  if (current_limit_A < 5.0f) Serial.printf("TWIN CURRENT LIMIT: %.2f A\n", current_limit_A);
  if (demo_mode) Serial.println(F("[DEMO MODE] own readings NOT published - on-chip AI runs on laptop replay"));
  if (dis.active) Serial.printf("[EDGE AI] averaging discharge: %lu s so far\n", (millis() - dis.start_ms) / 1000);
  Serial.printf("[MQTT] %s\n", mqtt.connected() ? "connected, published above" : "NOT connected — readings still logged locally");
  Serial.println(F("=================================================\n"));
}

// ===========================================================================
//  17. SETUP
// ===========================================================================
void setup() {
  Serial.begin(115200);
  delay(500);
  Serial.println(F("\n===== EV BATTERY MONITOR — SINGLE ESP32 ====="));
  Serial.printf("Firmware: %s\n", FW_TAG);

  analogReadResolution(12);
  analogSetAttenuation(ADC_11db);

  Wire.begin(ADS1115_SDA, ADS1115_SCL);
  if (ads.begin(ADS1115_I2C_ADDR)) {
    ads.setGain(ADS_GAIN);
    ads.setDataRate(RATE_ADS1115_860SPS);   // REV B: fast reads (8 samples ~10 ms)
    ads_ok = true;
    Serial.println(F("ADS1115 found and configured (GAIN_ONE, +-4.096V)"));
  } else {
    ads_ok = false;
    Serial.println(F("ADS1115 NOT FOUND on I2C (SDA21/SCL22, addr 0x48) — check wiring"));
  }

  tempSensors.begin();
  Serial.printf("DS18B20 found: %d\n", tempSensors.getDeviceCount());

  dht.begin();

  ledcAttach(MOSFET_PWM_PIN, LOAD_PWM_FREQ, LOAD_PWM_RES_BITS);
  ledcWrite(MOSFET_PWM_PIN, 0);
  Serial.println(F("MOSFET load PWM on GPIO13, load OFF"));

  ledcAttach(FAN_PWM_PIN, FAN_PWM_FREQ, FAN_PWM_RES_BITS);
  ledcWrite(FAN_PWM_PIN, 0);
  Serial.println(F("Fan PWM on GPIO25, off"));

  Serial.println(F("Calibrating ACS712..."));
  delay(1500);
  calibrateCurrentZero();
  Serial.printf("ACS712 zero = %.4f V\n", acs712_zero_volts);
  Serial.printf("Current sensor read via %s\n", CURRENT_VIA_ADS ? "ADS1115 A3 (16-bit)" : "ESP32 ADC GPIO35");

  aiSelfTest();                       // REV B

  connectWiFi();
  mqtt.setServer(MQTT_HOST, MQTT_PORT);
  mqtt.setCallback(onMqttMessage);
  mqtt.setBufferSize(4096);
  mqtt.setKeepAlive(30);

  Serial.println(F("\n===== READY ====="));
  Serial.println(F("Commands (USB or MQTT battery/cmd/load, battery/cmd/sys):"));
  Serial.println(F("  LOAD:<amps>   STOP   CAL   ZERO   CYCLE   SYNC"));
  Serial.println(F("  LIMIT:<amps>|OFF   FAN:<0-100>|AUTO   DEMO_ON   DEMO_OFF"));
  Serial.println(F("==================\n"));

  last_sensor_ms = millis();
  last_control_ms = millis();
}

// ===========================================================================
//  18. MAIN LOOP
// ===========================================================================
void loop() {
  connectWiFi();
  connectMqtt();
  mqtt.loop();

  unsigned long now = millis();

  // ===== CONTROL LOOP (every 200ms) =====
  if (now - last_control_ms >= CONTROL_INTERVAL_MS) {
    last_control_ms = now;
    readCurrentALONE();
    runCurrentControl();
    checkSafetyCutoff();
  }

  // ===== SENSOR + COMPUTE LOOP (every 1000ms) =====
  if (now - last_sensor_ms >= SENSOR_INTERVAL_MS) {
    last_sensor_ms = now;
    // REV B: real time since the previous pass (the pass itself takes >1 s)
    sensor_dt_s = prev_sensor_pass_ms ? (now - prev_sensor_pass_ms) / 1000.0f : 1.0f;
    sensor_dt_s = constrain(sensor_dt_s, 0.2f, 5.0f);
    prev_sensor_pass_ms = now;

    // Temperature read FIRST and ALONE (OneWire settle), per the
    // original noise-isolation fix — still applies on one chip.
    readTemperaturesALONE();   // includes its own 200ms settle delay

    readCurrentALONE();
    delay(20);
    readAmbient();
    delay(10);
    readCellVoltages();
    delay(10);
    readPiezo();
    delay(10);
    readGas();

    updateCoulombCount();
    calculateSOC();
    calculateSOH();
    calculateRUL();
    calculateR0();
    calculateDerived();
    checkFaults();

    float tmax = bat.cell_temp[0];
    for (int i = 1; i < CELL_COUNT; i++) tmax = max(tmax, bat.cell_temp[i]);
    updateFan(tmax);

    checkThresholds();
    if (!demo_mode) aiFeedLocal();      // REV B: on-chip AI on the real pack
    buildOutDoc();

    printState();      // ALWAYS — independent of MQTT
    publishState();     // publishes only if MQTT connected; safe no-op otherwise
  }

  pollUsb();

  // REV B: leave demo mode by itself if the laptop stopped the replay
  if (demo_mode && millis() - last_demo_msg_ms > DEMO_TIMEOUT_MS) {
    Serial.println(F("No replay data for 30 s - leaving demo mode"));
    handleCommand("DEMO_OFF", "timeout");
  }

  if (millis() - lastStats >= 10000) {
    lastStats = millis();
    Serial.printf("[SUMMARY][%s] wifi=%s | mqtt=%s | %s\n",
                  statusText,
                  WiFi.status() == WL_CONNECTED ? "up" : "down",
                  mqtt.connected() ? "up" : "down",
                  warnBuf[0] ? warnBuf : "-");
  }
}
